## meta-socket_app/conf/layer.conf
```bitbake
# We have a conf and classes directory, add to BBPATH
BBPATH .= ":${LAYERDIR}"

# We have recipes-* directories, add to BBFILES
BBFILES += "${LAYERDIR}/recipes-*/*/*.bb \
            ${LAYERDIR}/recipes-*/*/*.bbappend"

BBFILE_COLLECTIONS += "socket_app"
BBFILE_PATTERN_socket_app = "^${LAYERDIR}/"
BBFILE_PRIORITY_socket_app = "5"
LAYERVERSION_socket_app = "1"
LAYERSERIES_COMPAT_socket_app = "kirkstone"
```
